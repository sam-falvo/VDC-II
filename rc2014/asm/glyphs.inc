; The following table contains all the ASCII character glyphs used by default
; in the font editor.  These are drawn by hand in raw binary, and not intended
; to be perfect; expect these glyphs to change in future versions (possibly
; using this very font editor to create the new set!).
;
; These are stored as 8x8 pixel tiles, starting with ASCII code $20 (space).
; The VDC expects 8x16 pixel tiles; the software which is responsible for loading
; these glyphs is expected to double-up each scanline accordingly.

	; 20

	DEFB 0,0,0,0,0,0,0,0

	; 21 !

	DEFB @00010000
	DEFB @00010000
	DEFB @00010000
	DEFB @00010000
	DEFB @00010000
	DEFB @00000000
	DEFB @00010000
	DEFB @00000000

	; 22 "

	DEFB @00100100
	DEFB @00100100
	DEFB @00100100
	DEFB @00000000
	DEFB @00000000
	DEFB @00000000
	DEFB @00000000
	DEFB @00000000

	; 23 #

	DEFB @00100100
	DEFB @00100100
	DEFB @01111110
	DEFB @00100100
	DEFB @01111110
	DEFB @00100100
	DEFB @00100100
	DEFB @00000000

	; 24 $

	DEFB @00010000
	DEFB @00111110
	DEFB @01010000
	DEFB @00111100
	DEFB @00010010
	DEFB @01111100
	DEFB @00010000
	DEFB @00000000

	; 25 %

	DEFB @00000000
	DEFB @01000010
	DEFB @00000100
	DEFB @00001000
	DEFB @00010000
	DEFB @00100000
	DEFB @01000010
	DEFB @00000000

	; 26 &

	DEFB @00011000
	DEFB @00100000
	DEFB @00100000
	DEFB @00110000
	DEFB @01001010
	DEFB @01000100
	DEFB @00111010
	DEFB @00000000

	; 27 '

	DEFB @00001000
	DEFB @00001000
	DEFB @00010000
	DEFB @00000000
	DEFB @00000000
	DEFB @00000000
	DEFB @00000000
	DEFB @00000000

	; 28 (

	DEFB @00000100
	DEFB @00001000
	DEFB @00010000
	DEFB @00010000
	DEFB @00010000
	DEFB @00001000
	DEFB @00000100
	DEFB @00000000

	; 29 )

	DEFB @00100000
	DEFB @00010000
	DEFB @00001000
	DEFB @00001000
	DEFB @00001000
	DEFB @00010000
	DEFB @00100000
	DEFB @00000000

	; 2A *

	DEFB @00010000
	DEFB @01010100
	DEFB @00111000
	DEFB @01111100
	DEFB @00111000
	DEFB @01010100
	DEFB @00010000
	DEFB @00000000

	; 2B +

	DEFB @00000000
	DEFB @00010000
	DEFB @00010000
	DEFB @01111100
	DEFB @00010000
	DEFB @00010000
	DEFB @00000000
	DEFB @00000000

	; 2C ,

	DEFB @00000000
	DEFB @00000000
	DEFB @00000000
	DEFB @00000000
	DEFB @00000000
	DEFB @00001000
	DEFB @00001000
	DEFB @00010000

	; 2D -

	DEFB @00000000
	DEFB @00000000
	DEFB @00000000
	DEFB @01111110
	DEFB @00000000
	DEFB @00000000
	DEFB @00000000
	DEFB @00000000

	; 2E .

	DEFB @00000000
	DEFB @00000000
	DEFB @00000000
	DEFB @00000000
	DEFB @00000000
	DEFB @00011000
	DEFB @00011000
	DEFB @00000000

	; 2F /

	DEFB @00000000
	DEFB @00000010
	DEFB @00000100
	DEFB @00001000
	DEFB @00010000
	DEFB @00100000
	DEFB @01000000
	DEFB @00000000

	; 30-39

	DEFB @00111100
	DEFB @01000110
	DEFB @01001010
	DEFB @01011010
	DEFB @01010010
	DEFB @01100010
	DEFB @00111100
	DEFB @00000000


	DEFB @00010000
	DEFB @00110000
	DEFB @00010000
	DEFB @00010000
	DEFB @00010000
	DEFB @00010000
	DEFB @01111100
	DEFB @00000000


	DEFB @00111100
	DEFB @01000010
	DEFB @00000010
	DEFB @00111100
	DEFB @01000000
	DEFB @01000000
	DEFB @01111110
	DEFB @00000000


	DEFB @00111100
	DEFB @01000010
	DEFB @00000010
	DEFB @00011100
	DEFB @00000010
	DEFB @01000010
	DEFB @00111100
	DEFB @00000000


	DEFB @00000100
	DEFB @00001100
	DEFB @00010100
	DEFB @00100100
	DEFB @01111110
	DEFB @00000100
	DEFB @00000100
	DEFB @00000000


	DEFB @01111110
	DEFB @01000000
	DEFB @01111100
	DEFB @00000010
	DEFB @00000010
	DEFB @01000010
	DEFB @00111100
	DEFB @00000000


	DEFB @00011100
	DEFB @00100000
	DEFB @01000000
	DEFB @01111100
	DEFB @01000010
	DEFB @01000010
	DEFB @00111100
	DEFB @00000000


	DEFB @01111110
	DEFB @00000010
	DEFB @00000100
	DEFB @00001000
	DEFB @00010000
	DEFB @00100000
	DEFB @01000000
	DEFB @00000000


	DEFB @00111100
	DEFB @01000010
	DEFB @01000010
	DEFB @00111100
	DEFB @01000010
	DEFB @01000010
	DEFB @00111100
	DEFB @00000000


	DEFB @00111100
	DEFB @01000010
	DEFB @01000010
	DEFB @00111110
	DEFB @00000010
	DEFB @00000100
	DEFB @00111000
	DEFB @00000000

	; 3A :

	DEFB @00000000
	DEFB @00000000
	DEFB @00001000
	DEFB @00000000
	DEFB @00000000
	DEFB @00001000
	DEFB @00000000
	DEFB @00000000

	; 3B ;

	DEFB @00000000
	DEFB @00000000
	DEFB @00001000
	DEFB @00000000
	DEFB @00000000
	DEFB @00001000
	DEFB @00001000
	DEFB @00010000

	; 3C <

	DEFB @00000100
	DEFB @00001000
	DEFB @00010000
	DEFB @00100000
	DEFB @00010000
	DEFB @00001000
	DEFB @00000100
	DEFB @00000000

	; 3D =

	DEFB @00000000
	DEFB @00000000
	DEFB @01111110
	DEFB @00000000
	DEFB @01111110
	DEFB @00000000
	DEFB @00000000
	DEFB @00000000

	; 3E >

	DEFB @00100000
	DEFB @00010000
	DEFB @00001000
	DEFB @00000100
	DEFB @00001000
	DEFB @00010000
	DEFB @00100000
	DEFB @00000000

	; 3F ?

	DEFB @00111100
	DEFB @01000010
	DEFB @00000010
	DEFB @00001100
	DEFB @00010000
	DEFB @00000000
	DEFB @00010000
	DEFB @00000000

	; 40 @

	DEFB @00111100
	DEFB @01000010
	DEFB @01001110
	DEFB @01010010
	DEFB @01001110
	DEFB @01000000
	DEFB @00111100
	DEFB @00000000

	; 41 A

	DEFB @00011000
	DEFB @00100100
	DEFB @01000010
	DEFB @01111110
	DEFB @01000010
	DEFB @01000010
	DEFB @01000010
	DEFB @00000000

	; 42 B

	DEFB @01111100
	DEFB @00100010
	DEFB @00100010
	DEFB @00111100
	DEFB @00100010
	DEFB @00100010
	DEFB @01111100
	DEFB @00000000

	; 43 C

	DEFB @00011100
	DEFB @00100010
	DEFB @01000000
	DEFB @01000000
	DEFB @01000000
	DEFB @00100010
	DEFB @00011100
	DEFB @00000000

	; 44 D

	DEFB @01111000
	DEFB @00100100
	DEFB @00100010
	DEFB @00100010
	DEFB @00100010
	DEFB @00100100
	DEFB @01111000
	DEFB @00000000

	; 45 E

	DEFB @01111110
	DEFB @01000000
	DEFB @01000000
	DEFB @01111000
	DEFB @01000000
	DEFB @01000000
	DEFB @01111110
	DEFB @00000000

	; 46 F

	DEFB @01111110
	DEFB @01000000
	DEFB @01000000
	DEFB @01111000
	DEFB @01000000
	DEFB @01000000
	DEFB @01000000
	DEFB @00000000

	; 47 G

	DEFB @00011100
	DEFB @00100010
	DEFB @01000000
	DEFB @01001110
	DEFB @01000010
	DEFB @00100010
	DEFB @00011100
	DEFB @00000000

	; 48 H

	DEFB @01000010
	DEFB @01000010
	DEFB @01000010
	DEFB @01111110
	DEFB @01000010
	DEFB @01000010
	DEFB @01000010
	DEFB @00000000

	; 49 I

	DEFB @00111000
	DEFB @00010000
	DEFB @00010000
	DEFB @00010000
	DEFB @00010000
	DEFB @00010000
	DEFB @00111000
	DEFB @00000000

	; 4A J

	DEFB @00001110
	DEFB @00000100
	DEFB @00000100
	DEFB @00000100
	DEFB @00000100
	DEFB @01000100
	DEFB @00111000
	DEFB @00000000

	; 4B K

	DEFB @01000100
	DEFB @01001000
	DEFB @01010000
	DEFB @01100000
	DEFB @01010000
	DEFB @01001000
	DEFB @01000100
	DEFB @00000000

	; 4C L

	DEFB @01000000
	DEFB @01000000
	DEFB @01000000
	DEFB @01000000
	DEFB @01000000
	DEFB @01000000
	DEFB @01111110
	DEFB @00000000

	; 4D M

	DEFB @01000010
	DEFB @01100110
	DEFB @01011010
	DEFB @01011010
	DEFB @01000010
	DEFB @01000010
	DEFB @01000010
	DEFB @00000000

	; 4E N

	DEFB @01000010
	DEFB @01100010
	DEFB @01010010
	DEFB @01001010
	DEFB @01000110
	DEFB @01000010
	DEFB @01000010
	DEFB @00000000

	; 4F O

	DEFB @00111100
	DEFB @01000010
	DEFB @01000010
	DEFB @01000010
	DEFB @01000010
	DEFB @01000010
	DEFB @00111100
	DEFB @00000000

	; 50 P

	DEFB @01111100
	DEFB @01000010
	DEFB @01000010
	DEFB @01111100
	DEFB @01000000
	DEFB @01000000
	DEFB @01000000
	DEFB @00000000

	; 51 Q

	DEFB @00011000
	DEFB @00100100
	DEFB @01000010
	DEFB @01000010
	DEFB @01000010
	DEFB @00100100
	DEFB @00011000
	DEFB @00000110

	; 52 R

	DEFB @01111100
	DEFB @01000010
	DEFB @01000010
	DEFB @01111100
	DEFB @01010000
	DEFB @01001000
	DEFB @01000100
	DEFB @00000000

	; 53 S

	DEFB @00111100
	DEFB @01000010
	DEFB @01000000
	DEFB @00111100
	DEFB @00000010
	DEFB @01000010
	DEFB @00111100
	DEFB @00000000

	; 54 T

	DEFB @01111100
	DEFB @00010000
	DEFB @00010000
	DEFB @00010000
	DEFB @00010000
	DEFB @00010000
	DEFB @00010000
	DEFB @00000000

	; 55 U

	DEFB @01000010
	DEFB @01000010
	DEFB @01000010
	DEFB @01000010
	DEFB @01000010
	DEFB @01000010
	DEFB @00111100
	DEFB @00000000

	; 56 V

	DEFB @01000010
	DEFB @01000010
	DEFB @01000010
	DEFB @00100100
	DEFB @00100100
	DEFB @00011000
	DEFB @00011000
	DEFB @00000000

	; 57 W

	DEFB @01000010
	DEFB @01000010
	DEFB @01000010
	DEFB @01000010
	DEFB @01011010
	DEFB @01100110
	DEFB @01000010
	DEFB @00000000

	; 58 X

	DEFB @01000010
	DEFB @01000010
	DEFB @00100100
	DEFB @00011000
	DEFB @00011000
	DEFB @00100100
	DEFB @01000010
	DEFB @00000000

	; 59 Y

	DEFB @01000100
	DEFB @01000100
	DEFB @00101000
	DEFB @00101000
	DEFB @00010000
	DEFB @00010000
	DEFB @00010000
	DEFB @00000000

	; 5A Z

	DEFB @01111110
	DEFB @00000010
	DEFB @00000100
	DEFB @00011000
	DEFB @00100000
	DEFB @01000000
	DEFB @01111110
	DEFB @00000000

	; 5B [

	DEFB @00111100
	DEFB @00100000
	DEFB @00100000
	DEFB @00100000
	DEFB @00100000
	DEFB @00100000
	DEFB @00111100
	DEFB @00000000

	; 5C \

	DEFB @00000000
	DEFB @01000000
	DEFB @00100000
	DEFB @00010000
	DEFB @00001000
	DEFB @00000100
	DEFB @00000010
	DEFB @00000000

	; 5D ]

	DEFB @00111100
	DEFB @00000100
	DEFB @00000100
	DEFB @00000100
	DEFB @00000100
	DEFB @00000100
	DEFB @00111100
	DEFB @00000000

	; 5E ^

	DEFB @00010000
	DEFB @00101000
	DEFB @00101000
	DEFB @01000100
	DEFB @00000000
	DEFB @00000000
	DEFB @00000000
	DEFB @00000000

	; 5F _

	DEFB @00000000
	DEFB @00000000
	DEFB @00000000
	DEFB @00000000
	DEFB @00000000
	DEFB @00000000
	DEFB @00000000
	DEFB @01111110

	; 60 @

	DEFB @00010000
	DEFB @00010000
	DEFB @00001000
	DEFB @00000000
	DEFB @00000000
	DEFB @00000000
	DEFB @00000000
	DEFB @00000000

	; 61 a

	DEFB @00000000
	DEFB @00000000
	DEFB @00111100
	DEFB @00000010
	DEFB @00111110
	DEFB @01000010
	DEFB @00111110
	DEFB @00000000

	; 62 B

	DEFB @01000000
	DEFB @01000000
	DEFB @01000000
	DEFB @01111100
	DEFB @01000010
	DEFB @01000010
	DEFB @01111100
	DEFB @00000000

	; 63 C

	DEFB @00000000
	DEFB @00000000
	DEFB @00111100
	DEFB @01000010
	DEFB @01000000
	DEFB @01000010
	DEFB @00111100
	DEFB @00000000

	; 64 D

	DEFB @00000010
	DEFB @00000010
	DEFB @00111110
	DEFB @01000010
	DEFB @01000010
	DEFB @01000010
	DEFB @00111110
	DEFB @00000000

	; 65 E

	DEFB @00000000
	DEFB @00000000
	DEFB @00111100
	DEFB @01000010
	DEFB @01111110
	DEFB @01000000
	DEFB @00111100
	DEFB @00000000

	; 66 F

	DEFB @00001100
	DEFB @00010000
	DEFB @00010000
	DEFB @01111100
	DEFB @00010000
	DEFB @00010000
	DEFB @00010000
	DEFB @00000000

	; 67 G

	DEFB @00000000
	DEFB @00000000
	DEFB @00111110
	DEFB @01000010
	DEFB @01000010
	DEFB @00111110
	DEFB @00000010
	DEFB @00111100

	; 68 H

	DEFB @01000000
	DEFB @01000000
	DEFB @01000000
	DEFB @01111100
	DEFB @01000010
	DEFB @01000010
	DEFB @01000010
	DEFB @00000000

	; 69 I

	DEFB @00010000
	DEFB @00000000
	DEFB @00010000
	DEFB @00010000
	DEFB @00010000
	DEFB @00010000
	DEFB @00001000
	DEFB @00000000

	; 6A J

	DEFB @00000100
	DEFB @00000000
	DEFB @00000100
	DEFB @00000100
	DEFB @00000100
	DEFB @00000100
	DEFB @01000100
	DEFB @00111000

	; 6B K

	DEFB @00100000
	DEFB @00100000
	DEFB @00100100
	DEFB @00101000
	DEFB @00110000
	DEFB @00101000
	DEFB @00100100
	DEFB @00000000

	; 6C L

	DEFB @00010000
	DEFB @00010000
	DEFB @00010000
	DEFB @00010000
	DEFB @00010000
	DEFB @00010000
	DEFB @00001000
	DEFB @00000000

	; 6D M

	DEFB @00000000
	DEFB @00000000
	DEFB @01111100
	DEFB @01011010
	DEFB @01011010
	DEFB @01000010
	DEFB @01000010
	DEFB @00000000

	; 6E N

	DEFB @00000000
	DEFB @00000000
	DEFB @01011100
	DEFB @01100010
	DEFB @01000010
	DEFB @01000010
	DEFB @01000010
	DEFB @00000000

	; 6F O

	DEFB @00000000
	DEFB @00000000
	DEFB @00111100
	DEFB @01000010
	DEFB @01000010
	DEFB @01000010
	DEFB @00111100
	DEFB @00000000

	; 70 P

	DEFB @00000000
	DEFB @00000000
	DEFB @01111100
	DEFB @01000010
	DEFB @01000010
	DEFB @01111100
	DEFB @01000000
	DEFB @01000000

	; 71 Q

	DEFB @00000000
	DEFB @00000000
	DEFB @00111110
	DEFB @01000010
	DEFB @01000010
	DEFB @00111110
	DEFB @00000010
	DEFB @00000010

	; 72 R

	DEFB @00000000
	DEFB @00000000
	DEFB @01011100
	DEFB @01100010
	DEFB @01000000
	DEFB @01000000
	DEFB @01000000
	DEFB @00000000

	; 73 S

	DEFB @00000000
	DEFB @00000000
	DEFB @00111110
	DEFB @01000000
	DEFB @00111100
	DEFB @00000010
	DEFB @01111100
	DEFB @00000000

	; 74 T

	DEFB @00010000
	DEFB @00010000
	DEFB @01111100
	DEFB @00010000
	DEFB @00010000
	DEFB @00010000
	DEFB @00001100
	DEFB @00000000

	; 75 U

	DEFB @00000000
	DEFB @00000000
	DEFB @01000010
	DEFB @01000010
	DEFB @01000010
	DEFB @01000010
	DEFB @00111110
	DEFB @00000000

	; 76 V

	DEFB @00000000
	DEFB @00000000
	DEFB @01000010
	DEFB @01000010
	DEFB @00100100
	DEFB @00100100
	DEFB @00011000
	DEFB @00000000

	; 77 W

	DEFB @00000000
	DEFB @00000000
	DEFB @01000010
	DEFB @01000010
	DEFB @01011010
	DEFB @01011010
	DEFB @01111100
	DEFB @00000000

	; 78 X

	DEFB @00000000
	DEFB @00000000
	DEFB @01000100
	DEFB @00101000
	DEFB @00010000
	DEFB @00101000
	DEFB @01000100
	DEFB @00000000

	; 79 Y

	DEFB @00000000
	DEFB @00000000
	DEFB @01000010
	DEFB @01000010
	DEFB @01000010
	DEFB @00111110
	DEFB @00000010
	DEFB @00111100

	; 7A Z

	DEFB @00000000
	DEFB @00000000
	DEFB @01111110
	DEFB @00000100
	DEFB @00011000
	DEFB @00100000
	DEFB @01111110
	DEFB @00000000

	; 7B {

	DEFB @00001100
	DEFB @00010000
	DEFB @00010000
	DEFB @01100000
	DEFB @00010000
	DEFB @00010000
	DEFB @00001100
	DEFB @00000000

	; 7C |

	DEFB @00010000
	DEFB @00010000
	DEFB @00010000
	DEFB @00010000
	DEFB @00010000
	DEFB @00010000
	DEFB @00010000
	DEFB @00000000

	; 7D }

	DEFB @00110000
	DEFB @00001000
	DEFB @00001000
	DEFB @00000110
	DEFB @00001000
	DEFB @00001000
	DEFB @00110000
	DEFB @00000000

	; 7E ~

	DEFB @01100010
	DEFB @10010010
	DEFB @10001100
	DEFB @00000000
	DEFB @00000000
	DEFB @00000000
	DEFB @00000000
	DEFB @00000000

	; 7F (delete)

	DEFB @11111000
	DEFB @10000100
	DEFB @10101010
	DEFB @10010001
	DEFB @10101010
	DEFB @10000100
	DEFB @11111000
	DEFB @00000000

